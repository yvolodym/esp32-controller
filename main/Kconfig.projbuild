## main/Kconfig.projbuild
```kconfig
menu "ESP32 Controller Configuration"

    config CONTROLLER_RECEIVER_MAC
        string "Receiver MAC Address"
        default "FF:FF:FF:FF:FF:FF"
        help
            MAC address of the ESP-NOW receiver device in format XX:XX:XX:XX:XX:XX
            Use FF:FF:FF:FF:FF:FF for broadcast or set specific receiver MAC

    config CONTROLLER_SEND_DELAY_MS
        int "Send delay in milliseconds"
        range 10 1000
        default 20
        help
            Delay between ESP-NOW transmissions

    config CONTROLLER_JOYSTICK_DEADZONE
        int "Joystick deadzone"
        range 10 200
        default 50
        help
            Deadzone for joystick input filtering

endmenu
```

## sdkconfig.defaults
```kconfig
CONFIG_ESP32_DEFAULT_CPU_FREQ_240=y
CONFIG_ESP32_XTAL_FREQ_40=y

CONFIG_ESPTOOLPY_FLASHSIZE_4MB=y
CONFIG_PARTITION_TABLE_OFFSET=0x10000
CONFIG_ESPTOOLPY_FLASHFREQ_80M=y
CONFIG_ESPTOOLPY_FLASHMODE_QIO=y

CONFIG_SPIRAM_USE=y
CONFIG_SPIRAM_SUPPORT=y
CONFIG_ESP32_SPIRAM_SUPPORT=y
CONFIG_SPIRAM_SPEED_80M=y
CONFIG_SPIRAM_BOOT_INIT=y
CONFIG_SPIRAM_TYPE_AUTO=y
CONFIG_SPIRAM_SIZE=-1

CONFIG_FREERTOS_HZ=1000
CONFIG_COMPILER_OPTIMIZATION_PERF=y

CONFIG_ESP32_WIFI_STATIC_RX_BUFFER_NUM=16
CONFIG_ESP32_WIFI_DYNAMIC_RX_BUFFER_NUM=32
CONFIG_ESP32_WIFI_DYNAMIC_TX_BUFFER_NUM=32
CONFIG_ESP32_WIFI_AMPDU_TX_ENABLED=y
CONFIG_ESP32_WIFI_TX_BA_WIN=6
CONFIG_ESP32_WIFI_RX_BA_WIN=6
```
